## config/boards/shields/totem/Kconfig.defconfig
```kconfig
# Copyright (c) 2022 The ZMK Contributors
# SPDX-License-Identifier: MIT

if SHIELD_TOTEM_CENTRAL_DONGLE

config ZMK_KEYBOARD_NAME
    default "Totem Dongle"

config ZMK_SPLIT_ROLE_CENTRAL
    default y

endif

if SHIELD_TOTEM_LEFT

config ZMK_KEYBOARD_NAME
    default "TOTEM"

endif

if SHIELD_TOTEM_LEFT || SHIELD_TOTEM_RIGHT || SHIELD_TOTEM_CENTRAL_DONGLE

config ZMK_SPLIT
    default y

endif

if SHIELD_TOTEM_CENTRAL_DONGLE && ZMK_DISPLAY

config I2C
    default y

config SSD1306
    default y

endif
```

## config/boards/shields/totem/Kconfig.shield
```kconfig
# Copyright (c) 2022 The ZMK Contributors
# SPDX-License-Identifier: MIT

config SHIELD_TOTEM_LEFT
    def_bool $(shields_list_contains,totem_left)

config SHIELD_TOTEM_RIGHT
    def_bool $(shields_list_contains,totem_right)

config SHIELD_DONGLE_DISPLAY
	def_bool $(shields_list_contains,dongle_display)
```
